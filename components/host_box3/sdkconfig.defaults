## components/host_box3/sdkconfig.defaults
```kconfig
CONFIG_USB_HOST_ENABLED=y
CONFIG_USB_HOST_STACK_SIZE=4096
CONFIG_USB_HOST_TASK_PRIORITY=5
CONFIG_USB_HOST_CONTROL_TRANSFER_MAX_SIZE=256
CONFIG_USB_HOST_HW_BUFFER_BIAS_IN=0
CONFIG_ESP_PHY_GPIO_D_PLUS=2
CONFIG_ESP_PHY_GPIO_D_MINUS=6
```
